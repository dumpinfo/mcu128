// 单片机演唱歌 刀郎《2002年的第一场雪》
// 作者：chenming
// 出处：伟纳电子论坛  www.willar.com



#include <reg51.h>
sbit SPK=P3^7;
void delayms(unsigned char ms);
unsigned int data j;
unsigned char code song[636]={ 0xFF,0xFF,4,0xFd,0x08,2,0xFd,0x08,2,0xFd,0x08,2,0xFd,0x08,2,0xFd,0x08,2,0xfd,0x08,2,				//21
							  0xFD,0x5B,4,0xFD,0x08,2,0xFC,0xAB,2,0xFC,0x0B,2,0xFC,0x0B,2,0xff,0xff,2,0xFc,0x0B,2,				//21
							  0xFC,0xAB,2,0xFC,0xAB,2,0xFC,0xAB,2,0xFC,0xAB,2,0xFC,0xAB,4,0xFC,0xAB,2,0xFC,0xAB,2,				//21	
							  0xFB,0x8F,2,0xFC,0x0B,2,0xFC,0x0B,4,0xff,0xff,8,									 				//12
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							  0xfc,0xab,2,0xfd,0x08,2,0xfd,0x08,2,0xfd,0x08,2,0xff,0xff,4,0xff,0xff,4};							//18,42,636	

void main()
{	TMOD = 0x01;
	IE = 0x82;
		while(1)
		{	j=0;
   		 	while (j<636)
			 	{	TR0=1;
			  		if ((song[j]==0xff)&&(song[j+1]==0xff)) TR0=0;//休止符用0xff,0xff表示,出现休止符时CT0禁止,不发声.
			  		delayms(song[j+2]);							  //每一音符唱多长.
		 	  		j=j+3;
			 	}
		}
}

void timer0() interrupt 1 using 1								  //每一音符唱多高
{	TH0=song[j];
	TL0=song[j+1];
	SPK = !SPK;	
}
void delayms(unsigned char ms)									  //基本延时子程序(16分之1拍的时间)
{	unsigned int i;	
	while(ms--)
	{
		for(i = 0; i < 20300; i++);
	}
	TR0=0;
	
}
